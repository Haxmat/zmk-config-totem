#include <dt-bindings/zmk/matrix_transform.h>
#include "totem.dtsi"

/ {
    chosen {
        zmk,kscan = &kscan0;
        zmk,matrix-transform = &default_transform;
        zmk,physical-layout = &default_layout; 
    };
};

&kscan0 {
    compatible = "zmk,kscan-mock";
    /delete-property/ diode-direction;
    /delete-property/ row-gpios;
    /delete-property/ col-gpios;
    columns = <0>;
    rows = <0>;
    events = <0>;
};